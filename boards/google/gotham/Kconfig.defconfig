## boards/google/gotham/Kconfig.defconfig
```kconfig
# Copyright 2026 Thomas Hebb
# SPDX-License-Identifier: Apache-2.0

if BOARD_GOOGLE_GOTHAM

if BT

choice AIROC_PART
        default BT_AIROC_CUSTOM
endchoice

config BT_BUF_ACL_TX_COUNT
	default 15

config BT_BUF_EVT_RX_COUNT
	default 16

config BT_BUF_ACL_TX_SIZE
	default 251

endif # BT

endif # BOARD_GOOGLE_GOTHAM
```

## boards/google/gotham/Kconfig.google_gotham
```kconfig
# Copyright 2026 Thomas Hebb
# SPDX-License-Identifier: Apache-2.0

config BOARD_GOOGLE_GOTHAM
	select SOC_PART_NUMBER_MIMXRT1062DVL6A
```

## boards/google/gotham/board.yml
```yaml
board:
  name: google_gotham
  full_name: Google Stadia Controller
  vendor: google
  socs:
    - name: mimxrt1062
```

## boards/google/gotham/google_gotham_mimxrt1062_defconfig
```kconfig
#
# Copyright (c) 2018, NXP
#
# SPDX-License-Identifier: Apache-2.0
#

CONFIG_CONSOLE=y
CONFIG_UART_CONSOLE=y
CONFIG_SERIAL=y
CONFIG_GPIO=y
CONFIG_ARM_MPU=y
CONFIG_HW_STACK_PROTECTION=y

# Avoid the BootROM-reserved region of OCRAM2
CONFIG_FLASH_LOAD_OFFSET=0x8000
```

## boards/google/gotham/google_gotham_mimxrt1062_ram_defconfig
```kconfig
#
# Copyright (c) 2026 Thomas Hebb
#
# SPDX-License-Identifier: Apache-2.0
#

CONFIG_CONSOLE=y
CONFIG_UART_CONSOLE=y
CONFIG_SERIAL=y
CONFIG_GPIO=y
CONFIG_ARM_MPU=y
CONFIG_HW_STACK_PROTECTION=y

# Enable triggers
CONFIG_REGULATOR=y
CONFIG_REGULATOR_FIXED=y

# Avoid the BootROM-reserved region of OCRAM2
CONFIG_FLASH_LOAD_OFFSET=0x8000
```

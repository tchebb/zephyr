/*
 * Copyright (c) 2026 Thomas Hebb
 *
 * SPDX-License-Identifier: Apache-2.0
 */

#include "google_gotham_mimxrt1062.dtsi"

/ {
	chosen {
		zephyr,flash = &zd25lq128;
		zephyr,sram = &ocram2;
		zephyr,code-partition = &slot_a_partition;
	};
};
